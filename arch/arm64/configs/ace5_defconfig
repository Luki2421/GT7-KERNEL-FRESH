## arch/arm64/configs/ace5_defconfig
```kconfig
CONFIG_ARM64=y
CONFIG_ZRAM=y
CONFIG_PREEMPT=y
CONFIG_SUGOV_EXT_INPUT_BOOST=y
CONFIG_KERNEL_SU=y
CONFIG_SUSFS=y
CONFIG_TCP_CONG_BBR=y
CONFIG_HIGH_RES_TIMERS=y
```
